/* Copyright (c) 2018, The Linux Foundation. All rights reserved.
 * Copyright (c) 2018, Raphielscape LLC.
 *
 * SPDX-License-Identifier: GPL-2.0-or-later
 */

 &soc {
     qcom,msm-thermal {
                qcom,poll-ms = <1000>; // Do pooling every 1 seconds
     };
     qcom,bcl {
                /delete-property/ qcom,bcl-hotplug-list;
                /delete-property/ qcom,bcl-soc-hotplug-list;
        };
 };