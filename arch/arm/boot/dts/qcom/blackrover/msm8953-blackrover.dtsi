/* Copyright (c) 2018, The Linux Foundation. All rights reserved.
 * Copyright (c) 2018, Raphielscape LLC.
 *
 * SPDX-License-Identifier: GPL-2.0-or-later
 */

 #include "msm8953-general-blackrover.dtsi"
 #include "msm8953-gpu-blackrover.dtsi"
 #include "msm8953-regulator-blackrover.dtsi"
 #include "msm8953-panel-blackrover.dtsi"